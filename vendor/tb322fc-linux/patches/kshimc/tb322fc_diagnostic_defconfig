## vendor/tb322fc-linux/patches/kshimc/tb322fc_diagnostic_defconfig
```kconfig
# Android-base RAM diagnostic, derived from tb322fc_android_defconfig.
CONFIG_QCOM_KEYS=y
CONFIG_QCOM_SPMI=y
CONFIG_QCOM_KEY_DEBOUNCE_SAMPLES=2
# CONFIG_KSHIM_QEMU_PLATFORM is not set
CONFIG_KSHIM_FRAMEBUFFER=y
CONFIG_KSHIM_LVGL=y
CONFIG_KSHIM_UI_ROTATION_CCW=270
CONFIG_KSHIM_MENU_ENTRY_DURATION_MS=0
CONFIG_KSHIM_LVGL_BUFFER_BYTES=243712
# CONFIG_KSHIM_TOUCH is not set
# CONFIG_KSHIM_SMP is not set
# CONFIG_KSHIM_UEFI_TEST_MENU is not set
# CONFIG_ENABLE_BANNER is not set
CONFIG_DEBUG_LEVEL_NONE=y
# CONFIG_KSHIM_DEBUG_CONSOLE is not set
CONFIG_ASSERT_HALT=y
CONFIG_KSHIM_MENU_STYLE_STAR_CHART=y
CONFIG_KSHIM_MENU_LANGUAGE_SWITCH=y
CONFIG_KSHIM_MENU_SESSION_SETTINGS=y
CONFIG_KSHIM_MENU_CHINESE=y
CONFIG_KSHIM_MENU_ENTRY_DETAILS=y
CONFIG_KSHIM_MENU_BASE_ANDROID=y
CONFIG_KSHIM_MENU_SINGLE_LINUX=y
# CONFIG_KSHIM_MENU_POWER_ACTIONS is not set
# CONFIG_KSHIM_MENU_ADVANCED_ACTIONS is not set
# CONFIG_KSHIM_QCOM_REBOOT is not set
# CONFIG_KSHIM_BOOT_LAST is not set
# CONFIG_KSHIM_CHARGER_MODE is not set
# CONFIG_KSHIM_SPLASH_FALLBACK is not set
# CONFIG_KSHIM_BOOT_TIMING is not set
# CONFIG_KSHIM_DIAG_PAINT is not set
CONFIG_KSHIM_DIAG_MARKER=y
CONFIG_KSHIM_DIAGNOSTIC_MENU_LIMIT_MS=20000
```

## vendor/tb322fc-linux/uefi/Kconfig
```kconfig
if TARGET_Y700_RAM

config SYS_BOARD
	default "y700-ram"

config SYS_VENDOR
	default "lenovo"

config SYS_CONFIG_NAME
	default "y700-ram"

config TEXT_BASE
	default 0x80000000

config LNX_KRNL_IMG_TEXT_OFFSET_BASE
	default 0x80000000

config Y700_RAM_LAB
	bool "Host-only QEMU entry contract"
	default n
	select PL01X_SERIAL
	select DM_CLK
	select CLK
	select CLK_FIXED_RATE
	help
	  Accept QEMU's FDT and expose its serial console. This image must
	  never be packaged as a tablet candidate.

endif
```

## vendor/tb322fc-linux/uefi/defconfig
```kconfig
CONFIG_ARM=y
CONFIG_TARGET_Y700_RAM=y
CONFIG_SKIP_LOWLEVEL_INIT=y
CONFIG_POSITION_INDEPENDENT=y
CONFIG_INIT_SP_RELATIVE=y
CONFIG_SYS_INIT_SP_BSS_OFFSET=0x200000
CONFIG_NR_DRAM_BANKS=256
CONFIG_SYS_MALLOC_LEN=0x2000000
CONFIG_SYS_MALLOC_F_LEN=0x10000
CONFIG_STACK_SIZE=0x40000
CONFIG_SYS_LOAD_ADDR=0x0
CONFIG_ENV_IS_NOWHERE=y
CONFIG_ENV_SIZE=0x4000
CONFIG_BOOTDELAY=-2
CONFIG_USE_BOOTCOMMAND=y
CONFIG_BOOTCOMMAND="y700boot"
CONFIG_BOOTSTD_DEFAULTS=n
CONFIG_BOOTSTD=n
CONFIG_BOOTMETH_DISTRO=n
CONFIG_BOOTMETH_EFILOADER=n
CONFIG_BOOTMETH_EFI=n
CONFIG_BOOTMETH_SCRIPT=n
CONFIG_CMDLINE=y
CONFIG_HUSH_PARSER=y
CONFIG_CMD_BOOTEFI=y
CONFIG_CMD_BOOTEFI_BINARY=y
CONFIG_CMD_BOOTEFI_BOOTMGR=n
CONFIG_CMD_BOOTM=y
CONFIG_CMD_BOOTI=n
CONFIG_CMD_BOOTZ=n
CONFIG_CMD_SAVEENV=n
CONFIG_CMD_NET=n
CONFIG_CMD_NFS=n
CONFIG_CMD_LOADB=n
CONFIG_CMD_LOADS=n
CONFIG_CMD_SOURCE=n
CONFIG_CMD_MEMORY=n
CONFIG_CMD_FS_GENERIC=y
CONFIG_CMD_FAT=y
CONFIG_BLKMAP=y
CONFIG_PARTITIONS=y
CONFIG_EFI_PARTITION=y
CONFIG_EFI_LOADER=y
CONFIG_EFI_VARIABLE_NO_STORE=y
CONFIG_EFI_VARIABLE_FILE_STORE=n
CONFIG_EFI_VARIABLE_SF_STORE=n
CONFIG_EFI_RUNTIME_UPDATE_CAPSULE=n
CONFIG_EFI_CAPSULE_ON_DISK=n
CONFIG_EFI_DEVICE_PATH_TO_TEXT=y
CONFIG_EFI_UNICODE_CAPITALIZATION=y
CONFIG_EFI_LOADER_HII=y
CONFIG_EFI_LOAD_FILE2_INITRD=y
CONFIG_FS_FAT=y
CONFIG_FAT_WRITE=n
CONFIG_FAT_RENAME=n
CONFIG_FS_EXT4=n
CONFIG_NET=n
CONFIG_USB=n
CONFIG_MMC=n
CONFIG_SCSI=n
CONFIG_UFS=n
CONFIG_NVME_PCI=n
CONFIG_MTD=n
CONFIG_SPI_FLASH=n
CONFIG_PCI=n
CONFIG_FASTBOOT=n
CONFIG_DFU=n
CONFIG_OF_BOARD=y
CONFIG_OF_SEPARATE=y
CONFIG_OF_EMBED=n
CONFIG_OF_UPSTREAM=n
CONFIG_DEFAULT_DEVICE_TREE=""
CONFIG_NULLDEV_SERIAL=y
CONFIG_REQUIRE_SERIAL_CONSOLE=n
CONFIG_SYSRESET=y
CONFIG_SYSRESET_PSCI=y
CONFIG_PSCI_RESET=y
CONFIG_VIDEO=y
CONFIG_VIDEO_SIMPLE=y
CONFIG_VIDEO_FONT_16X32=y
CONFIG_CONSOLE_ROTATION=y
CONFIG_VIDEO_ANSI=y
CONFIG_SYS_WHITE_ON_BLACK=y
CONFIG_NO_FB_CLEAR=y
CONFIG_GZIP=y
CONFIG_DISPLAY_CPUINFO=n
CONFIG_DISPLAY_BOARDINFO=n
CONFIG_SYS_CONSOLE_IS_IN_ENV=y
CONFIG_SYS_CONSOLE_ENV_OVERWRITE=y
CONFIG_LOG=y
CONFIG_LOG_DEFAULT_LEVEL=6
```
